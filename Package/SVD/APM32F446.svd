# APM32F446 register map
File version: 1.0
CPU: CM4 r0p1, little endian, MPU, FPU, 4 interrupt priority bits
Registers are 32-bit, read-write, reset 0x0 unless marked. A register's access mark holds for its fields unless they carry their own. Offsets are from the block's base; lines under a group give offsets from that group; [hi:lo] are bit positions; {n}, {i} and the like mark numbered series; 'fields as' and 'values as' point back to an identical list; <NAME> marks a mode.

## Memory map
0x14001000 CSE_PRAM size 0x80
0x40000000 AC size 0x70 — Access Controller
0x40001000 MSC size 0x40C — Miscellaneous System Control
0x40008000 DMA size 0x1200 — Direct Memory Access
0x4000D000 MPU size 0x820 — Memory Protection Unit
0x40018000 EREP size 0x114 — Error Reporting
0x40019000 EINJ size 0x208 — Error Injection
0x40020000 FLASH size 0x30 — Flash Memory
0x40021000 DMACHM size 0x10 — DMA Memory Access Channel Multiplexer
0x40024000 CAN0 size 0xC0C — Configurable Controller local area network
0x40025000 CAN1 size 0xC0C — Configurable Controller local area network
0x40026000 CFGTMR3 size 0x224
0x40027000 ADC1 size 0x1E8
0x4002B000 CAN2 size 0xC0C — Configurable Controller local area network
0x4002C000 LPSPI0 size 0x78 — The LPSPI Memory Map/Register Definition can be found here.
0x4002D000 LPSPI1 size 0x78
0x4002E000 LPSPI2 size 0x78
0x40031000 PDU1 size 0x198 — Programmable Delay Unit 1
0x40032000 CRC size 0xC — Cyclic Redundancy Check
0x40036000 PDU0 size 0x198 — Programmable Delay Unit 0
0x40037000 LPITMR size 0x5C — Low Power Periodic Interrupt Timer
0x40038000 CFGTMR0 size 0x224 — Configurable Timer
0x40039000 CFGTMR1 size 0x224
0x4003A000 CFGTMR2 size 0x224
0x4003B000 ADC0 size 0x1E8 — Analog-to-Digital Converter
0x4003D000 RTC size 0x20 — Real-time clock
0x40040000 LPTMR size 0x10 — Low Power Timer
0x40048000 SIM blocks up to offset 0x70 — System Integration Management
0x40049000 PMA size 0xCC — Port Management
0x4004A000 PMB size 0xCC
0x4004B000 PMC size 0xCC
0x4004C000 PMD size 0xCC
0x4004D000 PME size 0xCC
0x40052000 WDT size 0x10 — Software Watchdog Timer
0x4005A000 CFGIO size 0x510 — Configurable Communication Interface
0x40061000 EWDT size 0x6 — External Watchdog Timer
0x40063000 TMC size 0x78 — Trigger MUX Control
0x40064000 SCG size 0x60C — System Clock Generator
0x40065000 PCM size 0x1D0 — Peripheral Clock management
0x40066000 LPI2C size 0x174 — The LPI2C Memory Map/Register Definition can be found here.
0x4006A000 LPUART0 size 0x30 — Low-power Universal asynchronous receiver/transmitters
0x4006B000 LPUART1 size 0x30
0x4006C000 LPUART2 size 0x30
0x4006E000 CFGTMR4 size 0x224
0x4006F000 CFGTMR5 size 0x224
0x40073000 COMP size 0xC — Analog Comparators
0x4007D000 PMU size 0x5 — Power management unit
0x4007E000 SYSMC size 0x18 — System Mode Controller
0x4007F000 RMU size 0x20 — Reset Management unit
0x400FF000 GPIOA size 0x1C — General Purpose Input/Output
0x400FF040 GPIOB size 0x1C
0x400FF080 GPIOC size 0x1C
0x400FF0C0 GPIOD size 0x1C
0x400FF100 GPIOE size 0x1C
0xE000E000 APM32_SCB blocks up to offset 0xF40 — System Control Registers
0xE000E010 APM32_SysTick size 0x10 — System timer
0xE000E100 APM32_NVIC size 0xE04 — Nested Vectored Interrupt Controller
0xE0080000 MC blocks up to offset 0x4A8 — Core Platform Miscellaneous Control Module
0xE0082000 LMC size 0x24 — Local Memory Controller

## Interrupts
{n} DMA{n} (DMA, APM32_NVIC) (n=0..15)
16 DMA_Error (DMA, APM32_NVIC)
17 MC (APM32_NVIC, MC)
18 FLASH (FLASH, APM32_NVIC)
19 Read_Collision (FLASH, APM32_NVIC)
20 LVD_LVW (PMU, APM32_NVIC)
21 FLASH_Fault (FLASH, APM32_NVIC)
22 WDT_EWDT (WDT, EWDT, APM32_NVIC)
23 RMU (RMU, APM32_NVIC)
24 LPI2C_Master (LPI2C, APM32_NVIC)
25 LPI2C_Slave (LPI2C, APM32_NVIC)
26 LPSPI0 (LPSPI0, APM32_NVIC)
27 LPSPI1 (LPSPI1, APM32_NVIC)
28 LPSPI2 (LPSPI2, APM32_NVIC)
31 LPUART0_RxTx (LPUART0, APM32_NVIC)
33 LPUART1_RxTx (LPUART1, APM32_NVIC)
35 LPUART2_RxTx (LPUART2, APM32_NVIC)
39 ADC0 (ADC0, APM32_NVIC)
40 ADC1 (ADC1, APM32_NVIC)
41 COMP (COMP, APM32_NVIC)
44 EREP_single_fault (EREP, APM32_NVIC)
45 EREP_double_fault (EREP, APM32_NVIC)
46 RTC (RTC, APM32_NVIC)
47 RTC_Seconds (RTC, APM32_NVIC)
48 LPITMR_Ch0 (LPITMR, APM32_NVIC)
49 LPITMR_Ch1 (LPITMR, APM32_NVIC)
50 LPITMR_Ch2 (LPITMR, APM32_NVIC)
51 LPITMR_Ch3 (LPITMR, APM32_NVIC)
52 PDU0 (PDU0, APM32_NVIC)
57 SCG (SCG, APM32_NVIC)
58 LPTMR (LPTMR, APM32_NVIC)
59 PMA (PMA, APM32_NVIC)
60 PMB (PMB, APM32_NVIC)
61 PMC (PMC, APM32_NVIC)
62 PMD (PMD, APM32_NVIC)
63 PME (PME, APM32_NVIC)
64 SWI (APM32_NVIC)
68 PDU1 (PDU1, APM32_NVIC)
69 IO (CFGIO, APM32_NVIC)
78 CAN0_ORed (CAN0, APM32_NVIC)
79 CAN0_Error (CAN0, APM32_NVIC)
80 CAN0_Wake_Up (CAN0, APM32_NVIC)
81 CAN0_ORed_0_15_MB (CAN0, APM32_NVIC)
82 CAN0_ORed_16_31_MB (CAN0, APM32_NVIC)
85 CAN1_ORed (CAN1, APM32_NVIC)
86 CAN1_Error (CAN1, APM32_NVIC)
88 CAN1_ORed_0_15_MB (CAN1, APM32_NVIC)
89 CAN1_ORed_16_31_MB (CAN1, APM32_NVIC)
92 CAN2_ORed (CAN2, APM32_NVIC)
93 CAN2_Error (CAN2, APM32_NVIC)
95 CAN2_ORed_0_15_MB (CAN2, APM32_NVIC)
99 CFGTMR0_Ch0_Ch1 (CFGTMR0, APM32_NVIC)
100 CFGTMR0_Ch2_Ch3 (CFGTMR0, APM32_NVIC)
101 CFGTMR0_Ch4_Ch5 (CFGTMR0, APM32_NVIC)
102 CFGTMR0_Ch6_Ch7 (CFGTMR0, APM32_NVIC)
103 CFGTMR0_Fault (CFGTMR0, APM32_NVIC)
104 CFGTMR0_Ovf_Reload (CFGTMR0, APM32_NVIC)
105 CFGTMR1_Ch0_Ch1 (CFGTMR1, APM32_NVIC)
106 CFGTMR1_Ch2_Ch3 (CFGTMR1, APM32_NVIC)
107 CFGTMR1_Ch4_Ch5 (CFGTMR1, APM32_NVIC)
108 CFGTMR1_Ch6_Ch7 (CFGTMR1, APM32_NVIC)
109 CFGTMR1_Fault (CFGTMR1, APM32_NVIC)
110 CFGTMR1_Ovf_Reload (CFGTMR1, APM32_NVIC)
111 CFGTMR2_Ch0_Ch1 (CFGTMR2, APM32_NVIC)
112 CFGTMR2_Ch2_Ch3 (CFGTMR2, APM32_NVIC)
113 CFGTMR2_Ch4_Ch5 (CFGTMR2, APM32_NVIC)
114 CFGTMR2_Ch6_Ch7 (CFGTMR2, APM32_NVIC)
115 CFGTMR2_Fault (CFGTMR2, APM32_NVIC)
116 CFGTMR2_Ovf_Reload (CFGTMR2, APM32_NVIC)
117 CFGTMR3_Ch0_Ch1 (CFGTMR3, APM32_NVIC)
118 CFGTMR3_Ch2_Ch3 (CFGTMR3, APM32_NVIC)
119 CFGTMR3_Ch4_Ch5 (CFGTMR3, APM32_NVIC)
120 CFGTMR3_Ch6_Ch7 (CFGTMR3, APM32_NVIC)
121 CFGTMR3_Fault (CFGTMR3, APM32_NVIC)
122 CFGTMR3_Ovf_Reload (CFGTMR3, APM32_NVIC)
123 CFGTMR4_Ch0_Ch1 (CFGTMR4, APM32_NVIC)
124 CFGTMR4_Ch2_Ch3 (CFGTMR4, APM32_NVIC)
125 CFGTMR4_Ch4_Ch5 (CFGTMR4, APM32_NVIC)
126 CFGTMR4_Ch6_Ch7 (CFGTMR4, APM32_NVIC)
127 CFGTMR4_Fault (CFGTMR4, APM32_NVIC)
128 CFGTMR4_Ovf_Reload (CFGTMR4, APM32_NVIC)
129 CFGTMR5_Ch0_Ch1 (CFGTMR5, APM32_NVIC)
130 CFGTMR5_Ch2_Ch3 (CFGTMR5, APM32_NVIC)
131 CFGTMR5_Ch4_Ch5 (CFGTMR5, APM32_NVIC)
132 CFGTMR5_Ch6_Ch7 (CFGTMR5, APM32_NVIC)
133 CFGTMR5_Fault (CFGTMR5, APM32_NVIC)
134 CFGTMR5_Ovf_Reload (CFGTMR5, APM32_NVIC)
